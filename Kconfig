## Kconfig
```kconfig
menu "esp_libmbus"

    config MBUS_ENABLE_TCP
        bool "Enable M-Bus over TCP gateway transport"
        default n
        help
            Builds mbus-tcp.c and mbus_context_tcp(). Needs lwIP sockets.
            UART transport is always available.

endmenu
```

## examples/decode_frame/main/Kconfig.projbuild
```kconfig
menu "decode_frame example"

    config EXAMPLE_FRAME_HEX
        string "Frame(s) as hex"
        default "68 15 15 68 08 00 72 45 33 08 24 C5 14 00 04 01 00 00 00 04 13 78 56 34 12 27 16"
        help
            One or more complete M-Bus telegrams (68 .. 16) in hex, spaces
            allowed. Separate several telegrams of one readout with ';'.
            No meter or UART is needed, the frames are only decoded.

endmenu
```

## examples/read_bus/main/Kconfig.projbuild
```kconfig
menu "read_bus example"

    config EXAMPLE_UART_PORT
        int "UART port"
        default 1
        help
            UART0 is normally the console. C3 has UART0 and UART1 only.

    config EXAMPLE_UART_TX_PIN
        int "UART TX GPIO"
        default 6 if IDF_TARGET_ESP32C6
        default 4 if IDF_TARGET_ESP32C3
        default 17 if IDF_TARGET_ESP32 || IDF_TARGET_ESP32S3
        default 4

    config EXAMPLE_UART_RX_PIN
        int "UART RX GPIO"
        default 7 if IDF_TARGET_ESP32C6
        default 5 if IDF_TARGET_ESP32C3
        default 16 if IDF_TARGET_ESP32
        default 18 if IDF_TARGET_ESP32S3
        default 5

    config EXAMPLE_BAUDRATE
        int "Baud rate"
        default 2400
        help
            Ignored for the read if baud probing is enabled and finds a rate.

    choice EXAMPLE_PROFILE
        prompt "Meter profile"
        default EXAMPLE_PROFILE_GENERIC

        config EXAMPLE_PROFILE_GENERIC
            bool "Generic"
        config EXAMPLE_PROFILE_STRICT_FCB
            bool "Strict NKE + FCB"
        config EXAMPLE_PROFILE_SLOW
            bool "Slow answer window"
        config EXAMPLE_PROFILE_OPTICAL
            bool "Optical head (wake-up burst)"
    endchoice

    choice EXAMPLE_FIND_MODE
        prompt "How to find the meters"
        default EXAMPLE_FIND_PRIMARY

        config EXAMPLE_FIND_PRIMARY
            bool "Fixed list of primary addresses"
        config EXAMPLE_FIND_SCAN
            bool "Secondary address scan"
    endchoice

    config EXAMPLE_PRIMARY_LIST
        string "Primary addresses, comma separated"
        default "1,2,3"
        depends on EXAMPLE_FIND_PRIMARY
        help
            Each address 0..250 must belong to one meter only.

    config EXAMPLE_SCAN_FIRST_BYTE_MS
        int "Scan: first-byte wait per probe (ms)"
        range 20 2000
        default 120
        depends on EXAMPLE_FIND_SCAN
        help
            The scan needs about 100 probes per collision level, slow on a real bus.

    config EXAMPLE_MAX_METERS
        int "Maximum number of meters"
        range 1 32
        default 8

    config EXAMPLE_MAX_FAILS
        int "Failed reads in a row before a meter is parked"
        range 1 20
        default 3

    config EXAMPLE_PARK_ROUNDS
        int "Rounds a parked meter is skipped"
        range 1 100
        default 5

    config EXAMPLE_RESCAN_ROUNDS
        int "Find the meters again every N rounds (0 = never)"
        range 0 10000
        default 0

    config EXAMPLE_INTERVAL_S
        int "Pause between rounds (s)"
        range 1 3600
        default 30

    config EXAMPLE_TASK_STACK
        int "Reader task stack (bytes)"
        range 3072 16384
        default 4096

endmenu
```

## examples/read_meter/main/Kconfig.projbuild
```kconfig
menu "read_meter example"

    config EXAMPLE_UART_PORT
        int "UART port"
        default 1
        help
            UART0 is normally the console. C3 has UART0 and UART1 only.

    config EXAMPLE_UART_TX_PIN
        int "UART TX GPIO"
        default 6 if IDF_TARGET_ESP32C6
        default 4 if IDF_TARGET_ESP32C3
        default 17 if IDF_TARGET_ESP32 || IDF_TARGET_ESP32S3
        default 4

    config EXAMPLE_UART_RX_PIN
        int "UART RX GPIO"
        default 7 if IDF_TARGET_ESP32C6
        default 5 if IDF_TARGET_ESP32C3
        default 16 if IDF_TARGET_ESP32
        default 18 if IDF_TARGET_ESP32S3
        default 5

    config EXAMPLE_BAUDRATE
        int "Baud rate"
        default 2400
        help
            Ignored for the read if baud probing is enabled and finds a rate.

    choice EXAMPLE_ADDR_MODE
        prompt "Slave address type"
        default EXAMPLE_ADDR_PRIMARY

        config EXAMPLE_ADDR_PRIMARY
            bool "Primary"
        config EXAMPLE_ADDR_SECONDARY
            bool "Secondary"
    endchoice

    config EXAMPLE_PRIMARY_ADDR
        int "Primary address"
        range 0 250
        default 1
        depends on EXAMPLE_ADDR_PRIMARY

    config EXAMPLE_SECONDARY_ADDR
        string "Secondary address (16 hex digits)"
        default "FFFFFFFFFFFFFFFF"
        depends on EXAMPLE_ADDR_SECONDARY
        help
            id(8) manufacturer(4) version(2) medium(2). FF bytes are wildcards.
            All wildcards only works with a single slave on the bus.

    choice EXAMPLE_PROFILE
        prompt "Meter profile"
        default EXAMPLE_PROFILE_GENERIC

        config EXAMPLE_PROFILE_GENERIC
            bool "Generic"
        config EXAMPLE_PROFILE_STRICT_FCB
            bool "Strict NKE + FCB"
        config EXAMPLE_PROFILE_SLOW
            bool "Slow answer window"
        config EXAMPLE_PROFILE_OPTICAL
            bool "Optical head (wake-up burst)"
    endchoice

    config EXAMPLE_PROBE_BAUD
        bool "Probe the profile baud list before reading"
        default n

    config EXAMPLE_SCAN_AT_START
        bool "Run a secondary address scan once at start"
        default n
        help
            Needs about 100 probes per collision level. Slow on a real bus.

    config EXAMPLE_SCAN_FIRST_BYTE_MS
        int "Scan: first-byte wait per probe (ms)"
        range 20 2000
        default 120
        depends on EXAMPLE_SCAN_AT_START

    config EXAMPLE_INTERVAL_S
        int "Read interval (s)"
        range 1 3600
        default 10

    config EXAMPLE_TASK_STACK
        int "Reader task stack (bytes)"
        range 3072 16384
        default 4096

endmenu
```

## test_apps/main/Kconfig.projbuild
```kconfig
menu "esp_libmbus test app"

    config TB_UART_TX_PIN
        int "UART TX GPIO (jumper to RX)"
        default 6 if IDF_TARGET_ESP32C6
        default 4 if IDF_TARGET_ESP32C3
        default 17 if IDF_TARGET_ESP32 || IDF_TARGET_ESP32S3
        default 4

    config TB_UART_RX_PIN
        int "UART RX GPIO (jumper to TX)"
        default 7 if IDF_TARGET_ESP32C6
        default 5 if IDF_TARGET_ESP32C3
        default 16 if IDF_TARGET_ESP32
        default 18 if IDF_TARGET_ESP32S3
        default 5

    config TB_RUN_MENU
        bool "Unity menu instead of running all tests"
        default n

endmenu
```
